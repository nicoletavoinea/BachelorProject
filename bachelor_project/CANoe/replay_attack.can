/*@!Encoding:1252*/
includes{ 
}

variables{
  byte i;
  message CAN.* m_replay, m_replay1,m_replay2;
  timer t_replay1, t_replay2; 
  double cycle_time;
  dword output_file;
}

on Start{
  write("This function is called at the start of the CANoe simulation");
  output_file=openFileWrite("ReplayLabels.txt",2);
}


on stopMeasurement{
  fileClose(output_file);
}

on timer t_replay1{
  output(m_replay1);
}
on timer t_replay2{
  output(m_replay2);
}

on message CAN.*{
  if(this.TYPE == 1) // attack
  {
    filePutString("Intrusion\n",20,output_file);
    write("%d intrusion",this.id);
  }
  else {//prepare for next attack
    filePutString("Not Intrusion\n",20,output_file);
    write("%d NOT intrusion",this.id);

    if(this.id==353 || this.id==385 || this.id==421 || this.id==505) cycle_time=10000; //10ms
    if(this.id==580 || this.id==644 || this.id==645 ) cycle_time=20000; //20ms
    if(this.id==852) cycle_time=40000; //40ms
    if(this.id==1297 || this.id==1361 || this.id==1501 || this.id==1628 ) cycle_time=100000; //100ms
    
    //REPLAY
    if(random(100)<=30){//attacks on all messages & probability=20%
      m_replay=this;
      m_replay.TYPE=1;//set attack type flag
      
      if(isTimerActive(t_replay1)){
        m_replay2=m_replay;
        setTimer(t_replay2,0,random(2*cycle_time-1)*1000);
      }
      else{
        m_replay1=m_replay;
        setTimer(t_replay1,0,random(2*cycle_time-1)*1000);
      } 
    }
       
  }
}
