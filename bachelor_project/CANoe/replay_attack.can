/*@!Encoding:1252*/
includes{ 
}

variables{
  byte i;
  message CAN.* m_attack, m_replay;
  timer t_replay; 
  double cycle_time_10ms=10000;
  dword output_file;
}

on Start{
  write("This function is called at the start of the CANoe simulation");
  output_file=openFileWrite("output_replay.txt",2);
}

on stopMeasurement{
  fileClose(output_file);
}

on timer t_replay{
  output(m_replay);
}

on message CAN.*{
  if(this.TYPE == 1) // attack
    filePutString("Intrusion\n",20,output_file);
  else {//prepare for next attack
    filePutString("Not Intrusion\n",20,output_file);
    
    //REPLAY
    if(this.id == 385 && random(100)<=30){//attacks on message ID=385 & probability=30%
      m_replay=this;
      m_replay.TYPE=1;//set attack type flag
      if(!isTimerActive(t_replay))
        setTimer(t_replay,0,cycle_time_10ms*1000*random(10)); //send attack after x(random) sent messages
    }
  }
}
