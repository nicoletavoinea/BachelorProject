/*@!Encoding:1252*/
includes{ 
}

variables{
  dword output_file;
  byte i;
  message CAN.* m_attack,m_attack1,m_attack2;
  timer t_attack1, t_attack2;
  double cycle_time;
}

on Start{
  write("This function is called at the start of the CANoe simulation");
  output_file=openFileWrite("output_fuzzing.txt",2);
}

on stopMeasurement{
  fileClose(output_file);
}

on timer t_attack1{
  output(m_attack1);
}

on timer t_attack2{
  output(m_attack2);
}

on message CAN.*{
  if(this.TYPE == 1) // attack
    filePutString("Intrusion\n",20,output_file);
  else {//prepare for next attack
    filePutString("Not Intrusion\n",20,output_file);
    
    if(this.id==353 || this.id==385 || this.id==421 || this.id==505) cycle_time=10000; //10ms
      if(this.id==580 || this.id==644 || this.id==645 ) cycle_time=20000; //20ms
      if(this.id==852) cycle_time=40000; //40ms
      if(this.id==1297 || this.id==1361 || this.id==1501 || this.id==1628 ) cycle_time=100000; //100ms
    
    //FUZZING
    if(random(100)<=30){ //attacks on all messages & probability=20%
      m_attack.id=this.id;
      m_attack.dir=tx;
      m_attack.dlc=this.dlc;
      for(i=0;i<=7;i++)
        m_attack.byte(i)= random(255);
      m_attack.TYPE=1; //set attack type flag 
      
      if(isTimerActive(t_attack1)){
        m_attack2=m_attack;
        setTimer(t_attack2,0,random(cycle_time)*1000);
      }
      else{
        m_attack1=m_attack;
        setTimer(t_attack1,0,random(cycle_time)*1000);
      } 
    }
  }
}
