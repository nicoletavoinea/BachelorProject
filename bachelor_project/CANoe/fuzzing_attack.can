/*@!Encoding:1252*/
includes{ 
}

variables{
  dword output_file;
  byte i;
  message CAN.* m_attack,m_attack1,m_attack2;
  timer t_attack1, t_attack2;
}

on Start{
  write("This function is called at the start of the CANoe simulation");
  output_file=openFileWrite("output_fuzzing.txt",2);
}

on stopMeasurement{
  fileClose(output_file);
}

on timer t_attack1{
  output(m_attack1);
}

on timer t_attack2{
  output(m_attack2);
}

on message CAN.*{
  if(this.TYPE == 1) // attack
    filePutString("Intrusion\n",20,output_file);
  else {//prepare for next attack
    filePutString("Not Intrusion\n",20,output_file);
    
    //FUZZING
    if((this.id == 421 || this.id == 353) && random(100)<=30){ //attacks on message ID=421,353 & probability=30%
      m_attack.id=this.id;
      m_attack.dir=tx;
      m_attack.dlc=this.dlc;
      for(i=0;i<=7;i++)
        m_attack.byte(i)= random(255);
      m_attack.TYPE=1; //set attack type flag 
      
      if(isTimerActive(t_attack1)){
        m_attack2=m_attack;
        setTimer(t_attack2,0,random(10000)*1000);
      }
      else{
        m_attack1=m_attack;
        setTimer(t_attack1,0,random(10000)*1000);
      } 
    }
  }
}
